; *************************************************************
; *** Scatter-Loading Description File generated by uVision ***
; *************************************************************

LR_IROM1 {{ flash.address }} {{ flash.length }}  {    ; load region size_region
  ER_IROM1 {{ flash.address }} {{ flash.length }}  {  ; load address = execution address
   *.o (RESET, +First)
   *(InRoot$$Sections)
   .ANY (+RO)
  }
  RW_IRAM1 {{ ram.address }} {{ ram.length }} {  ; RW data
   .ANY (+RW +ZI)
  }
}





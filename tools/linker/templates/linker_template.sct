; *************************************************************
; *** Scatter-Loading Description File generated by uVision ***
; *************************************************************

LR_IROM1 {{ flash_addr }} {{ flash_size }}  {    ; load region size_region
  ER_IROM1 {{ flash_addr }} {{ flash_size }}  {  ; load address = execution address
   *.o (RESET, +First)
   *(InRoot$$Sections)
   .ANY (+RO)
  }
  RW_IRAM1 {{ ram_addr }} {{ ram_size }} {  ; RW data
   .ANY (+RW +ZI)
  }
}




